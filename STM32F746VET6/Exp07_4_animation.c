/* ============================================================================ */
/*		Exp07_4_animation.c : 간단한 애니메이션 그래픽			*/
/* ============================================================================ */
/*					programmed by Seung-Yong Lee in 2015.   */

#include "stm32f746xx.h"
#include "OK-STM746.h"

const unsigned short girl[7][32*57] = {		// greeting girl 32 x 57 pixel
{ 0x0104, 0x0104, 0x0104, 0x0104, 0x0104, 0x0104, 0x0104, 0x0104, // cut 1
  0x0104, 0x0104, 0x0104, 0x0104, 0x0104, 0x0104, 0x0104, 0x0104, 
  0x0104, 0x0104, 0x0104, 0x0104, 0x0104, 0x0104, 0x0104, 0x0104, 
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  0x0104, 0x0104, 0x0104, 0x0104, 0x0104, 0x0104, 0x0104, 0x0104 }};

int main(void)
{
  unsigned short i, cut, x, y, color;

  Initialize_MCU();				// initialize MCU and kit
  Delay_ms(50);					// wait for system stabilization
  Initialize_LCD();				// initialize text LCD module
  Initialize_TFT_LCD();				// initialize TFT-LCD module

  LCD_string(0x80,"OK-STM32F7  V1.0");		// display title
  LCD_string(0xC0,"   Exp07_4.c    ");

  while(1)
    { TFT_string(14,22, Cyan,Black, "안녕하세요 ?");
      for(cut = 0; cut <= 6; cut++)		// 머리를 숙이는 동작
        { i = 0;
	  for(y = 0; y < 57; y++)
            for(x = 0; x < 32; x++)
              { color = girl[cut][i++];
                TFT_pixel(x+144,y+92, color);
              }
          Delay_ms(100);
        }
      Delay_ms(500);

      for(cut = 7; cut > 0; cut--)		// 다시 되돌아 오는 동작
        { i = 0;
	  for(y = 0; y < 57; y++)
            for(x = 0; x < 32; x++)
              { color = girl[cut-1][i++];
                TFT_pixel(x+144,y+92, color);
              }
          Delay_ms(100);
        }
      TFT_string(14,22, Cyan,Black, "            ");
      Delay_ms(2000);
    }
}
