/* ========================================================================== */
/*	  Exp17_2.c : Visiting Count on Graphic LCD by Random Number          */
/* ========================================================================== */
/*			  Designed and programmed by Duck-Yong Yoon in 2006.  */

#include <avr/io.h>
#include <stdio.h>
#include <stdlib.h>
#include <avr/pgmspace.h>
#include "OK2561.h"

prog_uchar font[95][5] = {	                /* 5x7 ASCII character font */
	{0x00, 0x00, 0x00, 0x00, 0x00},		// 0x20 space
	{0x00, 0x00, 0x4f, 0x00, 0x00},		// 0x21 !
	{0x00, 0x07, 0x00, 0x07, 0x00},		// 0x22 "
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	{0x08, 0x04, 0x08, 0x10, 0x08}};	// 0x7e ~

/* -------------------------------------------------------------------------- */
/*   Graphic LCD Module : Hyundai LCD,HG12605NY-LY,128x64 dot,LED backlight   */
/* -------------------------------------------------------------------------- */
/* LCD_DATABUS(0x4000) : D0-D7 = DB0-DB7 (7-14, data bus)		      */
/* LCD_CONTROL(0x4100) :   GND = R/-W    (5, read/write)		      */
/*                          D4 = D/-I    (4, data/instruction)		      */
/*                          D5 = E       (6, enable)			      */
/*                          D6 = CS1     (15, chip select 1)		      */
/*                          D7 = CS2     (16, chip select 2)		      */

uint8_t xcharacter, ycharacter;		// x character(0-7), y character(0-19)
uint8_t cursor_flag, xcursor, ycursor;	// x and y cursor position(0-7, 0-19)

void GLCD_command(uint8_t signal,uint8_t command)       /* write a command */
{ LCD_CONTROL = signal & 0xC0;			// D/-I = 0
  asm volatile(" PUSH  R0 ");                   // delay for 500 ns
  asm volatile(" POP   R0 ");
  asm volatile(" PUSH  R0 ");
  asm volatile(" POP   R0 ");
  LCD_DATABUS = command;                        // write command
  LCD_CONTROL = (signal & 0xC0)|0x20;		// E = 1
  asm volatile(" PUSH  R0 ");                   // delay for 500 ns
  asm volatile(" POP   R0 ");
  asm volatile(" PUSH  R0 ");
  asm volatile(" POP   R0 ");
  LCD_CONTROL = signal & 0xC0;                  // E = 0
  asm volatile(" NOP      ");
  LCD_CONTROL = 0x00;				// clear all control signals
  Delay_us(10);                                 // wait for GLCD busy
}

void GLCD_data(uint8_t signal,uint8_t character)        /* write a data */
{ LCD_CONTROL = (signal & 0xC0)|0x10;		// D/-I = 1
  asm volatile(" PUSH  R0 ");                   // delay for 500 ns
  asm volatile(" POP   R0 ");
  asm volatile(" PUSH  R0 ");
  asm volatile(" POP   R0 ");
  LCD_DATABUS = character;                      // write data
  LCD_CONTROL = (signal & 0xC0)|0x30;		// E = 1
  asm volatile(" PUSH  R0 ");                   // delay for 500 ns
  asm volatile(" POP   R0 ");
  asm volatile(" PUSH  R0 ");
  asm volatile(" POP   R0 ");
  LCD_CONTROL = (signal & 0xC0)|0x10;           // E = 0
  asm volatile(" NOP      ");
  LCD_CONTROL = 0x00;				// clear all control signals
  Delay_us(10);                                 // wait GLCD busy
}

void GLCD_clear(void)				/* clear GLCD screen */
{ unsigned char i, j, x;

  LCD_CONTROL = 0x00;				// clear all control signals
  GLCD_command(0xC0,0x3F);			// CS1,CS2 display ON
  GLCD_command(0xC0,0xC0);			// CS1,CS2 display position

  x = 0xB8;
  for(i = 0; i <= 7; i++)
    { GLCD_command(0xC0,x);                     // X start addtess
      GLCD_command(0xC0,0x40);                  // Y start address
      for(j = 0; j <= 63; j++)
        GLCD_data(0xC0,0x00);			// clear CS1 and CS2 screen
      x++;
    }
}

void GLCD_xy(uint8_t x,uint8_t y)		/* set character position */
{ xcharacter = x;
  ycharacter = y;

  GLCD_command(0xC0,0xB8+xcharacter);		// X address

  if(ycharacter <= 9)				// if y <= 9, CS1 Y address
    GLCD_command(0x40,0x40+ycharacter*6+4);
  else						// if y >= 10, CS2 Y address
    GLCD_command(0x80,0x40+(ycharacter-10)*6);
}

void GLCD_character(uint8_t character)		/* display a character */
{ unsigned char i, signal, font_data;

  GLCD_xy(xcharacter,ycharacter);
  if(ycharacter <= 9)				// if y <= 9, CS1
    signal = 0x40;
  else						// if y >= 10, CS2
    signal = 0x80;
  for(i = 0; i <= 4; i++)
    { font_data = pgm_read_byte(&font[character-0x20][i]);
      if((cursor_flag == 1) && (xcharacter == xcursor) && (ycharacter == ycursor))
          GLCD_data(signal,font_data | 0x80);
      else
          GLCD_data(signal,font_data);
    }
  GLCD_data(signal,0x00);			// last byte 0x00

  ycharacter++;                                 // go next character position
  if(ycharacter == 20)
    { ycharacter = 0;
      xcharacter++;
    }
}

unsigned char visit_flag, x, y, table[8][20];	// visiting count variables

int main(void)
{ unsigned char i, j, count;
  unsigned int seed, random;

  MCU_initialize();                             // initialize MCU and kit
  Delay_ms(50);                                 // wait for system stabilization
  LCD_initialize();                             // initialize text LCD module
  Beep();

  GLCD_clear();		               		// initialize GLCD screen
  cursor_flag = 0;                              // cursor off

  LCD_string(0x80,"Graphic LCD Test");          // display title on text LCD
  LCD_string(0xC0," Visiting Count ");

  seed = ((unsigned int)RTC_SECOND) << 8;	// make seed of random number
  seed += (unsigned int)RTC_SECOND;
  seed *= (unsigned int)RTC_SECOND;
  srand(seed);			               	// initialize random number

  for(i = 0; i <= 7; i++)			// clear visit room
    for(j = 0; j <= 19; j++)
      table[i][j] = 0;
  visit_flag = 0;
  x = seed & 0x07;				// starting position
  y = seed & 0x0F;

  while(visit_flag == 0)
    { random = rand();				// get random number

      if(random <= 0x1FFF)			// 0x0000 - 0x1FFF
        { if(y != 19)
            { y++; table[x][y] += 1; } }
      else if(random <= 0x3FFF)			// 0x2000 - 0x3FFF
        { if(y != 0)
            { y--; table[x][y] += 1; } }
      else if(random <= 0x5FFF)			// 0x4000 - 0x5FFF
        { if(x != 7)
            { x++; table[x][y] += 1; } }
      else					// 0x6000 - 0x7FFF
        { if(x != 0)
            { x--; table[x][y] += 1; } }

      for(i = 0; i <= 7; i++)			// display visiting count
        for(j = 0; j <= 19; j++)
          { count = table[i][j];
            if(count >= 62) count = '*';
            else if(count >= 36) count = count - 36 + 'a';
            else if(count >= 10) count = count - 10 + 'A';
            else count = count + '0';
            GLCD_xy(i, j);
            GLCD_character(count);
          }
      Delay_ms(100);

      visit_flag = 1;				// check end
      for(i = 0; i <= 7; i++)
        for(j = 0; j <= 19; j++)
          if(table[i][j] == 0)
            visit_flag = 0;
    }

  Beep();                                       // complete sound
  while(1);
}
