/* ========================================================================== */
/*	  Exp17_1.c : ASCII(English)-Only Display on Graphic LCD Module       */
/* ========================================================================== */
/*			  Designed and programmed by Duck-Yong Yoon in 2006.  */

#include <avr/io.h>
#include <stdio.h>
#include <avr/pgmspace.h>
#include "OK2561.h"

prog_uchar font[95][5] = {	                /* 5x7 ASCII character font */
	{0x00, 0x00, 0x00, 0x00, 0x00},		// 0x20 space
	{0x00, 0x00, 0x4f, 0x00, 0x00},		// 0x21 !
	{0x00, 0x07, 0x00, 0x07, 0x00},		// 0x22 "
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	{0x08, 0x04, 0x08, 0x10, 0x08}};	// 0x7e ~

/* -------------------------------------------------------------------------- */
/*   Graphic LCD Module : Hyundai LCD,HG12605NY-LY,128x64 dot,LED backlight   */
/* -------------------------------------------------------------------------- */
/* LCD_DATABUS(0x4000) : D0-D7 = DB0-DB7 (7-14, data bus)		      */
/* LCD_CONTROL(0x4100) :   GND = R/-W    (5, read/write)		      */
/*                          D4 = D/-I    (4, data/instruction)		      */
/*                          D5 = E       (6, enable)			      */
/*                          D6 = CS1     (15, chip select 1)		      */
/*                          D7 = CS2     (16, chip select 2)		      */

uint8_t xcharacter, ycharacter;		// x character(0-7), y character(0-19)
uint8_t cursor_flag, xcursor, ycursor;	// x and y cursor position(0-7, 0-19)

void GLCD_command(uint8_t signal,uint8_t command)       /* write a command */
{ LCD_CONTROL = signal & 0xC0;			// D/-I = 0
  asm volatile(" PUSH  R0 ");                   // delay for 500 ns
  asm volatile(" POP   R0 ");
  asm volatile(" PUSH  R0 ");
  asm volatile(" POP   R0 ");
  LCD_DATABUS = command;                        // write command
  LCD_CONTROL = (signal & 0xC0)|0x20;		// E = 1
  asm volatile(" PUSH  R0 ");                   // delay for 500 ns
  asm volatile(" POP   R0 ");
  asm volatile(" PUSH  R0 ");
  asm volatile(" POP   R0 ");
  LCD_CONTROL = signal & 0xC0;                  // E = 0
  asm volatile(" NOP      ");
  LCD_CONTROL = 0x00;				// clear all control signals
  Delay_us(10);                                 // wait for GLCD busy
}

void GLCD_data(uint8_t signal,uint8_t character)        /* write a data */
{ LCD_CONTROL = (signal & 0xC0)|0x10;		// D/-I = 1
  asm volatile(" PUSH  R0 ");                   // delay for 500 ns
  asm volatile(" POP   R0 ");
  asm volatile(" PUSH  R0 ");
  asm volatile(" POP   R0 ");
  LCD_DATABUS = character;                      // write data
  LCD_CONTROL = (signal & 0xC0)|0x30;		// E = 1
  asm volatile(" PUSH  R0 ");                   // delay for 500 ns
  asm volatile(" POP   R0 ");
  asm volatile(" PUSH  R0 ");
  asm volatile(" POP   R0 ");
  LCD_CONTROL = (signal & 0xC0)|0x10;           // E = 0
  asm volatile(" NOP      ");
  LCD_CONTROL = 0x00;				// clear all control signals
  Delay_us(10);                                 // wait GLCD busy
}

void GLCD_clear(void)				/* clear GLCD screen */
{ unsigned char i, j, x;

  LCD_CONTROL = 0x00;				// clear all control signals
  GLCD_command(0xC0,0x3F);			// CS1,CS2 display ON
  GLCD_command(0xC0,0xC0);			// CS1,CS2 display position

  x = 0xB8;
  for(i = 0; i <= 7; i++)
    { GLCD_command(0xC0,x);                     // X start addtess
      GLCD_command(0xC0,0x40);                  // Y start address
      for(j = 0; j <= 63; j++)
        GLCD_data(0xC0,0x00);			// clear CS1 and CS2 screen
      x++;
    }
}

void GLCD_xy(uint8_t x,uint8_t y)		/* set character position */
{ xcharacter = x;
  ycharacter = y;

  GLCD_command(0xC0,0xB8+xcharacter);		// X address

  if(ycharacter <= 9)				// if y <= 9, CS1 Y address
    GLCD_command(0x40,0x40+ycharacter*6+4);
  else						// if y >= 10, CS2 Y address
    GLCD_command(0x80,0x40+(ycharacter-10)*6);
}

void GLCD_character(uint8_t character)		/* display a character */
{ unsigned char i, signal, font_data;

  GLCD_xy(xcharacter,ycharacter);
  if(ycharacter <= 9)				// if y <= 9, CS1
    signal = 0x40;
  else						// if y >= 10, CS2
    signal = 0x80;
  for(i = 0; i <= 4; i++)
    { font_data = pgm_read_byte(&font[character-0x20][i]);
      if((cursor_flag == 1) && (xcharacter == xcursor) && (ycharacter == ycursor))
          GLCD_data(signal,font_data | 0x80);
      else
          GLCD_data(signal,font_data);
    }
  GLCD_data(signal,0x00);			// last byte 0x00

  ycharacter++;                                 // go next character position
  if(ycharacter == 20)
    { ycharacter = 0;
      xcharacter++;
    }
}

void GLCD_string(uint8_t x,uint8_t y,uint8_t *string)	/* display a string */
{ xcharacter = x;
  ycharacter = y;

  while(*string != '\0')
     { GLCD_character(*string);			// display a charcater
       string++;
     }
}

int main(void)
{ unsigned char i;

  MCU_initialize();                             // initialize MCU and kit
  Delay_ms(50);                                 // wait for system stabilization
  LCD_initialize();                             // initialize text LCD module
  Beep();

  GLCD_clear();		               		// initialize GLCD screen
  cursor_flag = 0;                              // cursor off

  LCD_string(0x80,"Graphic LCD Test");          // display title on text LCD
  LCD_string(0xC0," ASCII(English) ");

  while(1)
    { GLCD_string(0,0,"  OK-2561 Kit V1.0  ");	// display screen 1
      GLCD_string(1,0,"     2006/10/01     ");
      GLCD_string(2,0,"                    ");
      GLCD_string(3,0,"     Designed by    ");
      GLCD_string(4,0,"   Duck-Yong Yoon.  ");
      GLCD_string(5,0,"                    ");
      GLCD_string(6,0,"      Made by       ");
      GLCD_string(7,0," Ohm Publishing Co. ");
      Delay_ms(5000);

      GLCD_string(0,0,"     Hyundai LCD    ");	// display screen 2
      GLCD_string(1,0,"    HG12605NY-LY    ");
      GLCD_string(2,0,"                    ");
      GLCD_string(3,0,"    Yellow/Green    ");
      GLCD_string(4,0," LED Backlight Type ");
      GLCD_string(5,0,"                    ");
      GLCD_string(6,0,"128 x 64 Graphic LCD");
      GLCD_string(7,0," 6x8 Box, 5x7 ASCII ");
      Delay_ms(5000);

      GLCD_string(0,0,"====================");	// display screen 3
      GLCD_string(1,0,"  ASCII Characters  ");
      GLCD_string(2,0,"====================");
      GLCD_string(7,0,"                    ");

      GLCD_xy(3,0);
      for(i=0x20; i<0x7F; i++)                  // from 0x20 to 0x7E
        GLCD_character(i);
      Delay_ms(5000);
    }
}
